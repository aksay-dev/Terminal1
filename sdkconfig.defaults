## sdkconfig.defaults
```kconfig
# LVGL: отключить субпиксельное сглаживание (цветные ореолы)
# CONFIG_LV_USE_FONT_SUBPX=n
# Если решите оставить субпиксель — для BGR-панели используйте так:
# CONFIG_LV_FONT_SUBPX_BGR=y

# LVGL: подключить большие шрифты
CONFIG_LV_FONT_MONTSERRAT_24=y
CONFIG_LV_FONT_MONTSERRAT_48=y
CONFIG_ESP_INT_WDT=n
CONFIG_ESP_TASK_WDT=n
CONFIG_ESPTOOLPY_FLASHSIZE_4MB=y

# Run-time checks of Heap and Stack
CONFIG_HEAP_POISONING_COMPREHENSIVE=y
CONFIG_COMPILER_STACK_CHECK_MODE_STRONG=y
CONFIG_COMPILER_STACK_CHECK=y
CONFIG_ESP_MAIN_TASK_STACK_SIZE=16000

CONFIG_UNITY_ENABLE_BACKTRACE_ON_FAIL=y
```
